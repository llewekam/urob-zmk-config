#define CONFIG_WIRELESS
#define ZMK_BASE_LAYER(name, LT, RT, LM, RM, LB, RB, LH, RH)                   \
    ZMK_LAYER(                                                                 \
        name,                                                                  \
        &kp RC(RG(Q)) LT &tog SYS RT &none                                     \
        &kp LS(RETURN) LM &tog NAV RM &none                                    \
        &kp LG(D) LB &kp LG(LS(LA(R))) RB &none                               \
        &none LH RH &none                                                      \
    )

#include "zmk-helpers/key-labels/42.h"
#include "base.keymap" 